## config/west.yml
```yaml
manifest:
  remotes:
    - name: zmkfirmware
      url-base: https://github.com/zmkfirmware
    - name: slicemk-module
      url-base: https://github.com/u-mikhalenka
  projects:
    - name: zmk
      remote: zmkfirmware
      revision: main
      import: app/west.yml
    - name: slicemk-module
      remote: slicemk-module
      path: modules/slicemk-module
      revision: main
  self:
    path: config
```
